## board/qemu/aarch64-virt/my_defconfig
```kconfig
# Base system
BR2_aarch64=y
BR2_TOOLCHAIN_BUILDROOT_GLIBC=y
BR2_TARGET_GENERIC_GETTY_PORT="ttyAMA0"

# Python3
BR2_PACKAGE_PYTHON3=y

# Tcl/Tk (needed for _tkinter)
BR2_PACKAGE_TCL=y
BR2_PACKAGE_TK=y

# Root filesystem
BR2_TARGET_ROOTFS_EXT2=y
BR2_TARGET_ROOTFS_EXT2_SIZE="256M"
```

## configs/my_defconfig
```kconfig
# Base system
BR2_aarch64=y
BR2_TOOLCHAIN_BUILDROOT_MUSL=y
BR2_TARGET_GENERIC_GETTY_PORT="ttyAMA0"

# Userland
BR2_PACKAGE_FASTFB=y

# Device management via devtmpfs
BR2_ROOTFS_DEVICE_CREATION_DYNAMIC_DEVTMPFS=y

# Linux kernel
BR2_LINUX_KERNEL=y
BR2_LINUX_KERNEL_USE_ARCH_DEFAULT_CONFIG=y
BR2_LINUX_KERNEL_IMAGE=y
BR2_LINUX_KERNEL_CONFIG_FRAGMENT_FILES="board/myfastboot/linux-fb.fragment board/myfastboot/linux-minimal.fragment"

# Root filesystem
BR2_TARGET_ROOTFS_CPIO=y
BR2_TARGET_ROOTFS_CPIO_GZIP=y
BR2_ROOTFS_OVERLAY="board/myfastboot/rootfs-overlay"
```

## configs/myfastboot_ros2_defconfig
```kconfig
# Secondary filesystem carrying ROS 2 userland
BR2_aarch64=y
BR2_TOOLCHAIN_EXTERNAL=y
BR2_TOOLCHAIN_EXTERNAL_BOOTLIN=y
BR2_TOOLCHAIN_EXTERNAL_BOOTLIN_AARCH64_GLIBC_STABLE=y
BR2_TARGET_GENERIC_GETTY_PORT="ttyAMA0"

# Core runtime pieces typically needed by ROS 2 deployments
BR2_PACKAGE_BASH=y
BR2_PACKAGE_CMAKE=y
BR2_PACKAGE_PYTHON3=y

# Root filesystem image (raw ext4 copied into a secondary partition)
BR2_ROOTFS_OVERLAY="board/myfastboot/ros2-overlay"
BR2_TARGET_ROOTFS_EXT2=y
BR2_TARGET_ROOTFS_EXT2_4=y
BR2_TARGET_ROOTFS_EXT2_SIZE="2048M"
BR2_TARGET_ROOTFS_EXT2_LABEL="ros2"
# BR2_TARGET_ROOTFS_TAR is not set
```

## package/fastfb/Config.in
```kconfig
config BR2_PACKAGE_FASTFB
	bool "fastfb"
	help
	  Tiny framebuffer clock application optimised for fast-boot experiments.
	  It waits for /dev/fb0, clears the screen, and renders an uptime clock
	  directly into the framebuffer without any userspace graphics stack.
```

## package/tk/Config.in
```kconfig
config BR2_PACKAGE_TK
    bool "tk"
    depends on BR2_PACKAGE_TCL
  depends on BR2_PACKAGE_XORG7
  select BR2_PACKAGE_XLIB_LIBX11
    help
      Tk is a GUI toolkit for Tcl. Python’s Tkinter module depends on it.

      https://www.tcl.tk/
```
